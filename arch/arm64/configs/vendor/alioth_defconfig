## drivers/oplus/Kconfig
```kconfig
# SPDX-License-Identifier: GPL-2.0-only
# Copyright (C) 2018-2020 Oplus. All rights reserved.

config OPLUS_FEATURE_OPROJECT
  tristate "config oplus project info for kernel"
  default y
  help
    define this config to define oplus project

config FG_TASK_UID
  tristate "config oplus fg task ui"
  default y
  help
    define this config to define oplus fg task ui

source "drivers/oplus/oplus_performance/oplus_nandswap/Kconfig"
```

## drivers/oplus/system/qcom_minidump/Kconfig
```kconfig
# SPDX-License-Identifier: GPL-2.0-only
# Copyright (C) 2018-2020 Oplus. All rights reserved.
config OPLUS_FEATURE_QCOM_MINIDUMP_ENHANCE
	 bool "qcom minidump enhance"
	default n
	depends on OXYGEN_OS
	help
            define this config to enable qcom minidump enhance.
```

## drivers/oplus/system/qcom_pmicwd/Kconfig
```kconfig
# SPDX-License-Identifier: GPL-2.0-only
# Copyright (C) 2018-2020 Oplus. All rights reserved.
config OPLUS_FEATURE_QCOM_PMICWD
	tristate "qcom pmic watchdog"
	default n
	depends on OXYGEN_OS
	help
            define this config to enable qcom pmic watchdog.
			export pwk dump interface to android for control pwkdump.
```

## drivers/platform/xiaomi/Kconfig
```kconfig
# Xiaomi configuration options

config MACH_XIAOMI
	bool "Xiaomi device"
	depends on ARCH_QCOM
	help
	  Support for Xiaomi products

config MACH_XIAOMI_SDM845
	bool "Xiaomi SDM845"
	depends on ARCH_SDM845
	select MACH_XIAOMI
	help
	  Support for SDM845-based Xiaomi variants

config MACH_XIAOMI_SM8250
	bool "Xiaomi SM8250"
	depends on ARCH_QCOM
	select MACH_XIAOMI
	help
	  Support for Xiaomi SM8250 devices

menu "Xiaomi board selection"

	config MACH_XIAOMI_ALIOTH
		bool "Xiaomi alioth board"
		select MACH_XIAOMI_SM8250
		help
		  Support for Redmi K40 / POCO F3 / Mi 11X

	config MACH_XIAOMI_APOLLO
		bool "Xiaomi apollo board"
		select MACH_XIAOMI_SM8250
		help
		  Support for Mi 10T / Mi 10T Pro / Redmi K30S Ultra

	config MACH_XIAOMI_CAS
		bool "Xiaomi cas board"
		select MACH_XIAOMI_SM8250
		help
		  Support for Mi 10 Ultra

	config MACH_XIAOMI_CMI
		bool "Xiaomi cmi board"
		select MACH_XIAOMI_SM8250
		help
		  Support for Mi 10 Pro

	config MACH_XIAOMI_DAGU
		bool "Xiaomi dagu board"
		select MACH_XIAOMI_SM8250
		help
		  Support for Xiaomi Pad 5 Pro 12.4

	config MACH_XIAOMI_E10
        bool "E10 board"
        select MACH_XIAOMI_SDM845
        help
          Support for Xiaomi Poco F1 (beryllium)

	config MACH_XIAOMI_ELISH
		bool "Xiaomi elish board"
		select MACH_XIAOMI_SM8250
		help
		  Support for Xiaomi Pad 5 Pro Wi-Fi

	config MACH_XIAOMI_ENUMA
		bool "Xiaomi enuma board"
		select MACH_XIAOMI_SM8250
		help
		  Support for Xiaomi Pad 5 Pro 5G

	config MACH_XIAOMI_LMI
		bool "Xiaomi lmi board"
		select MACH_XIAOMI_SM8250
		help
		  Support for Redmi K30 Pro / POCO F2 Pro

	config MACH_XIAOMI_MUNCH
		bool "Xiaomi munch board"
		select MACH_XIAOMI_SM8250
		help
		  Support for Redmi K40S / POCO F4

	config MACH_XIAOMI_PSYCHE
		bool "Xiaomi psyche board"
		select MACH_XIAOMI_SM8250
		help
		  Support for Xiaomi 12X

	config MACH_XIAOMI_THYME
		bool "Xiaomi thyme board"
		select MACH_XIAOMI_SM8250
		help
		  Support for Mi 10S

	config MACH_XIAOMI_UMI
		bool "Xiaomi umi board"
		select MACH_XIAOMI_SM8250
		help
		  Support for Mi 10

endmenu
```

## techpack/Kconfig
```kconfig
source techpack/data/drivers/rmnet/perf/Kconfig
source techpack/data/drivers/rmnet/shs/Kconfig
source techpack/wlan/Kconfig

source techpack/mi845/Kconfig

config OSSFOD
	bool "OSS FOD support"
	depends on BOARD_XIAOMI
	help
	  When this option is enabled, OSS FOD support will be added.
```
